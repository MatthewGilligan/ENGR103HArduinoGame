#include <Adafruit_CircuitPlayground.h> //libraries
#include <AsyncDelay.h>

AsyncDelay timer;
AsyncDelay levelTime;

const uint8_t spNEXT[]              PROGMEM ={0xAE,0xF6,0x16,0x3E,0x33,0x25,0x85,0xDA,0x5B,0x78,0x8F,0x34,0x5D,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0x00,0x00};

const uint8_t spGAMES[]             PROGMEM ={0xAA,0x15,0x24,0x2A,0xD6,0xE4,0xB6,0xB6,0x79,0x13,0xB1,0x5C,0xB2,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0x00,0x00};
const uint8_t spOVER[]              PROGMEM ={0xA7,0xD0,0xAE,0x2F,0x50,0xBA,0x9D,0x5C,0xDB,0xFA,0x24,0xCE,0x3A,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0x00,0x00};

uint32_t RED = CircuitPlayground.colorWheel(0);       // red
uint32_t BLUE = CircuitPlayground.colorWheel(160);    // blue




const int redPatterns[3][5] = { //alows for storing of patterns
  {1, 0, 1, 1, 0}, // Level 1
  {0, 1, 1, 1, 1}, // Level 2
  {1, 1, 0, 1, 0}  // Level 3
};

const int bluePatterns[3][5] = { //2d array
  {0, 1, 1, 0, 1}, // Level 1
  {1, 0, 1, 1, 0}, // Level 2
  {0, 1, 0, 1, 1}  // Level 3
};

int currentPosition = 0; //position in the array
int level = 1;
int score = 0; 

volatile bool button1 = false;
volatile bool button2 = false;

void setup() {
  Serial.begin(9600);
  CircuitPlayground.begin();

  timer.start(500, AsyncDelay::MILLIS); //500 ms between each update of the lights
  levelTime.start(30000, AsyncDelay::MILLIS); // 30 seconds per level

  attachInterrupt(digitalPinToInterrupt(4), button1ISR, FALLING); //interrupts on the main buttons
  attachInterrupt(digitalPinToInterrupt(5), button2ISR, FALLING);

  CircuitPlayground.clearPixels();
}

void loop() {
  if (!levelTime.isExpired()) { //if the level is still going on 

    if (timer.isExpired()) { //if the light timer expired
      CircuitPlayground.clearPixels(); //clear the pixels
      displayPattern(currentPosition); //update the pixels
      currentPosition = (currentPosition + 1) % 5; //shift currentPosition
      timer.restart(); //restart the timer
    }
    handleButtons(); //check the buttons
    } 
    else {
    // Advance to next level if available, otherwise game over
    if (level < 3) {
      level++;
      Serial.print("Level Up! Now on level ");
      Serial.println(level);
      levelTime.restart();
      currentPosition = 0;
      CircuitPlayground.clearPixels();
      delay(1500); //wait a bit so the player knows that the level is over
    } 
    else {
      // game Over
      Serial.println("Game Over");
      CircuitPlayground.speaker.say(spGAMES);
      CircuitPlayground.speaker.say(spOVER);
      CircuitPlayground.clearPixels();
      delay(1000000); // wait a super long time
    }
  }
}


void displayPattern(int pos) { //new display pattern function
  for (int i = 0; i < 5; i++) { //5 is the patternLength
    int pixelIndexRed = 4 - i; //make it so that the pixel lit up is the correct pixel. Make it correspond to 0-4
    if (redPatterns[level - 1][(pos + i) % 5]) { //5 is the length of the pattern
      CircuitPlayground.setPixelColor(pixelIndexRed, RED);
    }

    int pixelIndexBlue = 5 + i; //same thing but reversed for the 5-9
    if (bluePatterns[level - 1][(pos + i) % 5]) {
      CircuitPlayground.setPixelColor(pixelIndexBlue, BLUE);
    }
  }
}


void handleButtons() { //keeps track of the buttons and if they were pressed
  if (button1) {
    if (redPatterns[level - 1][(currentPosition - 1 + 5) % 5]) { //5 is the length of the pattern. //check if top is lit
      Serial.println("Red Scored!");
      CircuitPlayground.playTone(300, 100);
      score++;
    } else {
      score--;
    }
    button1 = false;
  }

  if (button2) {
    if (bluePatterns[level - 1][(currentPosition - 1 + 5) % 5]) { //check if top is lit (if the corresponding pin in the array is true)
      Serial.println("Blue Scored!");
      CircuitPlayground.playTone(600, 100);
      score++;
    } 
    else {
      score--;
    }
    button2 = false;
  }

  Serial.print("Level: ");
  Serial.print(level);
  Serial.print(" Score: ");
  Serial.println(score);
}

void button1ISR() {
  button1 = true;
}

void button2ISR() {
  button2 = true;
}
